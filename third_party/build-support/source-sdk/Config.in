## third_party/build-support/source-sdk/Config.in
```kconfig
config BR2_PACKAGE_DATAPUMP_SDK
	bool "DataPump desktop SDK"
	select BR2_PACKAGE_LIBGLVND
	select BR2_PACKAGE_LIBGLVND_DISPATCH_GL
	help
	  Build OpenGL link interfaces for Rev without building or shipping
	  a graphics driver. The destination system supplies its own driver.
```

## third_party/build-support/source-sdk/configs/datapump_defconfig
```kconfig
BR2_x86_64=y
BR2_x86_x86_64=y
BR2_TOOLCHAIN_BUILDROOT_GLIBC=y
BR2_GCC_VERSION_15_X=y
BR2_TOOLCHAIN_BUILDROOT_CXX=y
BR2_PACKAGE_GLIBC_KERNEL_COMPAT=y
BR2_GENERATE_LOCALE=""
BR2_KERNEL_HEADERS_6_1=y
BR2_SHARED_STATIC_LIBS=y
BR2_REPRODUCIBLE=y
BR2_DOWNLOAD_FORCE_CHECK_HASHES=y
BR2_INIT_NONE=y
BR2_SYSTEM_BIN_SH_NONE=y
# BR2_PACKAGE_BUSYBOX is not set
# BR2_TARGET_ROOTFS_TAR is not set
BR2_PACKAGE_HOST_CMAKE=y
BR2_PACKAGE_OPENSSL=y
BR2_PACKAGE_LIBOPENSSL=y
BR2_PACKAGE_ALSA_LIB=y
BR2_PACKAGE_XORG7=y
BR2_PACKAGE_XLIB_LIBX11=y
BR2_PACKAGE_XLIB_LIBXFT=y
BR2_PACKAGE_XLIB_LIBXEXT=y
BR2_PACKAGE_XLIB_LIBXRENDER=y
BR2_PACKAGE_XLIB_LIBXCURSOR=y
BR2_PACKAGE_XLIB_LIBXFIXES=y
BR2_PACKAGE_XLIB_LIBXINERAMA=y
BR2_PACKAGE_XLIB_LIBXRANDR=y
BR2_PACKAGE_FONTCONFIG=y
BR2_PACKAGE_FREETYPE=y
BR2_PACKAGE_DATAPUMP_SDK=y
BR2_PACKAGE_LIBGLEW=y
```
